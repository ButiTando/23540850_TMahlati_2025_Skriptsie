/**
  ******************************************************************************
  * @file    TestRigApp.cpp
  * @brief   ILT_TESTRIG -- the degrader and the dosimeter in one image.
  *
  * Three threads:
  *   supervisor  brings the network up, registers the API, starts the stream,
  *               then reports state changes and drives the LEDs;
  *   degrader    sequences the lens carousel (Degrader.cpp);
  *   dosimeter   samples the six pulse channels on a period (Dosimeter.cpp).
  *
  * The two rigs' original firmwares each owned a TCP server for commands and a
  * TCP client that dialled out with data. Here that is split by shape:
  *
  *   requests  -> HTTP on port 80, one path per operation, JSON replies;
  *   streaming -> one TCP port that clients connect to and stay connected to,
  *                receiving a JSON record per line as data is produced.
  *
  * A control station therefore needs no reconnect-per-sample and no bespoke
  * binary framing, and a browser or `curl` is enough to drive the rig by hand.
  ******************************************************************************
  */

#include "Application.h"
#include "Kernel.h"
#include "Thread.h"

#include "Bsp/Board.h"
#include "Bsp/Console.h"
#include "Bsp/Degrader.h"
#include "Bsp/Led.h"
#include "Bsp/PulseCounter.h"

#include "Net/HttpServer.h"
#include "Net/NetworkStack.h"
#include "Net/StreamServer.h"

#include "Degrader.h"
#include "Dosimeter.h"
#if ILT_EMBED_WEBSITE
/* Generated by tools/embed_website.py: the whole web UI as one gzipped HTTP
   response, living in its own flash region. */
extern "C" const unsigned char ilt_website_response[];
extern "C" const std::size_t   ilt_website_response_len;
#else
#include "IndexPage.h"
#endif

#include <cstdio>
#include <cstdlib>
#include <cstring>

/* Two levels so the macro argument is expanded before it is stringified. */
#define ILT_STRINGIFY_(x) #x
#define ILT_STRINGIFY(x) ILT_STRINGIFY_(x)

#ifndef TESTRIG_STACK_BYTES
#define TESTRIG_STACK_BYTES 1536
#endif
#ifndef TESTRIG_HOSTNAME
#define TESTRIG_HOSTNAME "ilt-testrig"
#endif
#ifndef TESTRIG_STREAM_PORT
#define TESTRIG_STREAM_PORT 5000
#endif
#ifndef TESTRIG_USE_DHCP
#define TESTRIG_USE_DHCP 1
#endif
#ifndef TESTRIG_DHCP_TIMEOUT_MS
#define TESTRIG_DHCP_TIMEOUT_MS 15000
#endif
#ifndef TESTRIG_FALLBACK_IP
#define TESTRIG_FALLBACK_IP 192, 168, 1, 200
#endif
#ifndef TESTRIG_FALLBACK_NETMASK
#define TESTRIG_FALLBACK_NETMASK 255, 255, 255, 0
#endif
#ifndef TESTRIG_FALLBACK_GATEWAY
#define TESTRIG_FALLBACK_GATEWAY 192, 168, 1, 1
#endif

namespace {

using ilt::net::HttpServer;
using ilt::net::HttpQuery;
using ilt::net::NetworkStack;
using ilt::net::NetworkState;
using ilt::net::StreamServer;

rig::Degrader  g_degrader;
rig::Dosimeter g_dosimeter;

constexpr std::uint32_t kSuperviseIntervalMs = 250U;

/* --- API routes ----------------------------------------------------------- */

const char *motionName(rig::Motion m) noexcept
{
    switch (m)
    {
    case rig::Motion::Selecting:  return "selecting";
    case rig::Motion::Inserting:  return "inserting";
    case rig::Motion::Retracting: return "retracting";
    case rig::Motion::Idle:
    default:                      return "idle";
    }
}

std::size_t renderDegrader(char *buffer, std::size_t capacity,
                           const HttpQuery &) noexcept
{
    const int n = std::snprintf(
        buffer, capacity,
        "{\"present\":%s,\"status\":%u,\"desired\":%u,\"current\":%u,"
        "\"word\":%u,\"moves\":%lu,\"failures\":%lu,"
        "\"motor\":{\"motion\":\"%s\",\"target\":%d,\"confirmed\":%d,"
        "\"steps\":%lu,\"milli_stations\":%lu,"
        "\"steps_per_station\":%lu,\"step_rate_hz\":%lu,\"stations\":%u}}",
        bsp::degrader::available() ? "true" : "false",
        static_cast<unsigned>(g_degrader.status()),
        static_cast<unsigned>(g_degrader.desiredMask()),
        static_cast<unsigned>(g_degrader.currentMask()),
        static_cast<unsigned>(g_degrader.responseWord()),
        static_cast<unsigned long>(g_degrader.movesCompleted()),
        static_cast<unsigned long>(g_degrader.moveFailures()),
        motionName(g_degrader.motion()),
        g_degrader.targetLens(),
        g_degrader.confirmedStation(),
        static_cast<unsigned long>(g_degrader.positionSteps()),
        static_cast<unsigned long>(g_degrader.positionMilliStations()),
        static_cast<unsigned long>(bsp::degrader::stepsPerStation()),
        static_cast<unsigned long>(bsp::degrader::stepRateHz()),
        static_cast<unsigned>(bsp::degrader::kLensCount));

    return (n > 0 && static_cast<std::size_t>(n) < capacity)
               ? static_cast<std::size_t>(n) : 0U;
}

std::size_t renderDegraderSet(char *buffer, std::size_t capacity,
                              const HttpQuery &query) noexcept
{
    std::uint32_t mask = 0U;
    if (!query.getUint("mask", mask))
    {
        const int n = std::snprintf(
            buffer, capacity,
            "{\"ok\":false,\"error\":\"expected ?mask=<0..127>\"}");
        return (n > 0 && static_cast<std::size_t>(n) < capacity)
                   ? static_cast<std::size_t>(n) : 0U;
    }

    const bool accepted = (mask <= 0x7FU) &&
                          g_degrader.request(static_cast<std::uint8_t>(mask));

    const int n = std::snprintf(
        buffer, capacity, "{\"ok\":%s,\"mask\":%u}",
        accepted ? "true" : "false", static_cast<unsigned>(mask));

    return (n > 0 && static_cast<std::size_t>(n) < capacity)
               ? static_cast<std::size_t>(n) : 0U;
}

std::size_t renderDosimeter(char *buffer, std::size_t capacity,
                            const HttpQuery &) noexcept
{
    rig::Sample s{};
    g_dosimeter.latest(s);

    const int n = std::snprintf(
        buffer, capacity,
        "{\"present\":%s,\"seq\":%lu,\"t_ms\":%lu,\"period_s\":%lu,"
        "\"ch\":[%lu,%lu,%lu,%lu,%lu,%lu]}",
        bsp::pulse::available() ? "true" : "false",
        static_cast<unsigned long>(s.sequence),
        static_cast<unsigned long>(s.uptimeMs),
        static_cast<unsigned long>(g_dosimeter.period()),
        static_cast<unsigned long>(s.counts[0]),
        static_cast<unsigned long>(s.counts[1]),
        static_cast<unsigned long>(s.counts[2]),
        static_cast<unsigned long>(s.counts[3]),
        static_cast<unsigned long>(s.counts[4]),
        static_cast<unsigned long>(s.counts[5]));

    return (n > 0 && static_cast<std::size_t>(n) < capacity)
               ? static_cast<std::size_t>(n) : 0U;
}

std::size_t renderDosimeterPeriod(char *buffer, std::size_t capacity,
                                  const HttpQuery &query) noexcept
{
    std::uint32_t seconds = 0U;
    const bool    given   = query.getUint("seconds", seconds);
    const bool    ok      = given && g_dosimeter.setPeriod(seconds);

    const int n = std::snprintf(
        buffer, capacity,
        "{\"ok\":%s,\"period_s\":%lu,\"min\":%lu,\"max\":%lu}",
        ok ? "true" : "false",
        static_cast<unsigned long>(g_dosimeter.period()),
        static_cast<unsigned long>(rig::Dosimeter::kMinPeriodS),
        static_cast<unsigned long>(rig::Dosimeter::kMaxPeriodS));

    return (n > 0 && static_cast<std::size_t>(n) < capacity)
               ? static_cast<std::size_t>(n) : 0U;
}

std::size_t renderStatus(char *buffer, std::size_t capacity,
                         const HttpQuery &) noexcept
{
    const auto &net    = NetworkStack::instance();
    const auto &http   = HttpServer::instance();
    const auto &stream = StreamServer::instance();

    char address[16];
    net.formatAddress(address, sizeof(address));

    const int n = std::snprintf(
        buffer, capacity,
        "{\"board\":\"%s\",\"ip\":\"%s\",\"uptime_s\":%lu,\"link\":%s,"
        "\"http_requests\":%lu,"
        "\"stream\":{\"port\":%u,\"clients\":%u,\"sent\":%lu,\"dropped\":%lu},"
        "\"degrader_present\":%s,\"dosimeter_present\":%s,\"simulated\":%s}",
        bsp::boardName(), address,
        static_cast<unsigned long>(ilt::kernel::tickCount() / 1000U),
        net.isLinkUp() ? "true" : "false",
        static_cast<unsigned long>(http.requestsServed()),
        static_cast<unsigned>(TESTRIG_STREAM_PORT),
        static_cast<unsigned>(stream.clientCount()),
        static_cast<unsigned long>(stream.sentRecords()),
        static_cast<unsigned long>(stream.droppedRecords()),
        bsp::degrader::available() ? "true" : "false",
        bsp::pulse::available() ? "true" : "false",
        (ILT_RIG_SIMULATED != 0) ? "true" : "false");

    return (n > 0 && static_cast<std::size_t>(n) < capacity)
               ? static_cast<std::size_t>(n) : 0U;
}

/* Answer the browser's automatic favicon request instead of 404ing it on every
   page load. 204 is the honest reply -- there is no icon -- and the cache
   header stops it being asked again for a day. */
constexpr char kNoFavicon[] =
    "HTTP/1.0 204 No Content\r\n"
    "Cache-Control: public, max-age=86400\r\n"
    "Connection: close\r\n"
    "\r\n";

/* --- supervisor ----------------------------------------------------------- */

class SupervisorThread : public ilt::StaticThread<TESTRIG_STACK_BYTES>
{
public:
    SupervisorThread() noexcept
        : StaticThread("rig", osPriorityNormal)
    {
    }

protected:
    void run() override
    {
        bsp::ledAllOff();
        bsp::consoleWriteLine("");
        bsp::consoleWrite("ILT_TESTRIG on ");
        bsp::consoleWriteLine(bsp::boardName());

#if ILT_RIG_SIMULATED
        bsp::consoleWriteLine("rig: SIMULATED hardware -- readings are synthetic");
#endif
        if (!bsp::degrader::available())
        {
            bsp::consoleWriteLine("rig: no degrader hardware on this board");
        }
        if (!bsp::pulse::available())
        {
            bsp::consoleWriteLine("rig: no pulse counters on this board");
        }

        if (!bringUp())
        {
            bsp::ledSet(bsp::Led::Fault, true);
            return;
        }

        /* Started only once the network is up, so a record can never be
           produced before there is anywhere to send it. */
        g_degrader.start();
        g_dosimeter.start();

        supervise();
    }

private:
    bool bringUp() noexcept
    {
        NetworkStack::Config config;
        config.hostname      = TESTRIG_HOSTNAME;
        config.useDhcp       = (TESTRIG_USE_DHCP != 0);
        config.dhcpTimeoutMs = TESTRIG_DHCP_TIMEOUT_MS;
        const std::uint8_t ip[4] = {TESTRIG_FALLBACK_IP};
        const std::uint8_t nm[4] = {TESTRIG_FALLBACK_NETMASK};
        const std::uint8_t gw[4] = {TESTRIG_FALLBACK_GATEWAY};
        std::memcpy(config.address, ip, sizeof(config.address));
        std::memcpy(config.netmask, nm, sizeof(config.netmask));
        std::memcpy(config.gateway, gw, sizeof(config.gateway));

        if (!NetworkStack::instance().start(config))
        {
            bsp::consoleWriteLine("net: interface did not start");
            return false;
        }

        auto &http = HttpServer::instance();
        const bool routed =
#if ILT_EMBED_WEBSITE
            /* Served straight from flash, gzipped, headers and all. Registered
               under "/" as well: httpd resolves a bare "/" by probing default
               filenames, but that probe is skipped once the URI carries a query
               string, so "/?v=1" would otherwise 404. */
            http.addRawResponse("/index.html", ilt_website_response,
                                ilt_website_response_len) &&
            http.addRawResponse("/", ilt_website_response,
                                ilt_website_response_len) &&
#else
            http.addPage("/index.html", app::kIndexHtml) &&
#endif
            http.addRawResponse("/favicon.ico", kNoFavicon,
                                sizeof(kNoFavicon) - 1U) &&
            http.addPage("/api/status.json", &renderStatus) &&
            http.addPage("/api/degrader.json", &renderDegrader) &&
            http.addPage("/api/degrader/set.json", &renderDegraderSet) &&
            http.addPage("/api/dosimeter.json", &renderDosimeter) &&
            http.addPage("/api/dosimeter/period.json", &renderDosimeterPeriod);

        if (!routed)
        {
            bsp::consoleWriteLine("http: route table full (raise ILT_HTTP_MAX_ROUTES)");
            return false;
        }

        if (!http.start())
        {
            bsp::consoleWriteLine("http: listener did not start");
            return false;
        }

        if (!StreamServer::instance().start(TESTRIG_STREAM_PORT))
        {
            bsp::consoleWriteLine("stream: listener did not start");
            return false;
        }

        bsp::consoleWriteLine("http: listening on port 80");
        bsp::consoleWriteLine("stream: listening on port " ILT_STRINGIFY(TESTRIG_STREAM_PORT));
        return true;
    }

    void supervise() noexcept
    {
        const auto &net = NetworkStack::instance();
        auto lastState = NetworkState::Stopped;
        std::uint32_t lastRecords = 0U;

        for (;;)
        {
            const NetworkState state = net.state();
            if (state != lastState)
            {
                reportState(state);
                lastState = state;
            }

            /* Solid once addressed, blinking while it is not, so the board's
               state is readable without a serial terminal. */
            if (state == NetworkState::Ready)
            {
                bsp::ledSet(bsp::Led::Status, true);
            }
            else
            {
                bsp::ledToggle(bsp::Led::Status);
            }

            const std::uint32_t records = StreamServer::instance().sentRecords();
            bsp::ledSet(bsp::Led::Activity, records != lastRecords);
            lastRecords = records;

            bsp::ledSet(bsp::Led::Fault,
                        g_degrader.status() == rig::ProcessStatus::Fault);

            sleep(kSuperviseIntervalMs);
        }
    }

    void reportState(NetworkState state) noexcept
    {
        const auto &net = NetworkStack::instance();

        switch (state)
        {
        case NetworkState::LinkDown:
            bsp::consoleWriteLine("net: link down");
            break;
        case NetworkState::Configuring:
            bsp::consoleWriteLine("net: link up, requesting an address");
            break;
        case NetworkState::Ready:
        {
            char address[16];
            net.formatAddress(address, sizeof(address));
            bsp::consoleWrite("net: ready -- http://");
            bsp::consoleWrite(address);
            bsp::consoleWriteLine("/  and stream on port "
                                  ILT_STRINGIFY(TESTRIG_STREAM_PORT));
            break;
        }
        default:
            bsp::consoleWriteLine("net: stopped");
            break;
        }
    }
};

SupervisorThread g_supervisor;

} // namespace

extern "C" void ILT_ApplicationStart(void)
{
    bsp::boardInit();
    g_supervisor.start();
}
